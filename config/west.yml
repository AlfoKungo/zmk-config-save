## config/west.yml
```yaml
manifest:
  remotes:
    - name: AlfoKungo
      url-base: https://github.com/AlfoKungo
  projects:
    - name: zmk
      remote: AlfoKungo
      revision: main
      import: app/west.yml
  self:
    path: config
```
